## config/west.yml
```yaml
manifest:
  remotes:
    - name: zmkfirmware
      url-base: https://github.com/zmkfirmware
    - name: refil
      url-base: https://github.com/refil
  projects:
    - name: zmk
      remote: refil
      revision: adv360-z3.5-2
      import: app/west.yml
    - name: position-trigger
      url: https://github.com/ReFil/refil-zmk-behaviour-modules
      revision: key-position-trigger
  self:
    path: config
```
